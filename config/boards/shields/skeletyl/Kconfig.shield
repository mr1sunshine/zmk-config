## config/boards/shields/skeletyl/Kconfig.shield
```kconfig
config SHIELD_SKELETYL
    bool

config SHIELD_SKELETYL_LEFT
	def_bool $(shields_list_contains,skeletyl_left)
	select SHIELD_SKELETYL

config SHIELD_SKELETYL_RIGHT
	def_bool $(shields_list_contains,skeletyl_right)
	select SHIELD_SKELETYL
```
